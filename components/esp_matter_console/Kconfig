## components/esp_matter_console/Kconfig
```kconfig
menu "ESP Matter Console"

    config ESP_MATTER_CONSOLE_USE_ESP_CONSOLE
        bool "Use ESP-IDF console REPL"
        depends on ENABLE_CHIP_SHELL
        depends on ESP_CONSOLE_UART_DEFAULT || ESP_CONSOLE_UART_CUSTOM || ESP_CONSOLE_USB_CDC || ESP_CONSOLE_USB_SERIAL_JTAG
        default n
        help
            Use esp_console instead of the CHIP shell main loop. The console
            uses the configured ESP-IDF UART or USB console transport and
            accepts the same matter esp commands.

    config ESP_MATTER_CONSOLE_NETWORK
        bool "Enable test-only Telnet console"
        depends on ESP_MATTER_CONSOLE_USE_ESP_CONSOLE && ENABLE_WIFI_STATION
        default n
        help
            Expose matter esp commands and logs over Telnet, without TLS or
            authentication. Use only in an isolated test LAN. Only one
            network client is served. USB console remains available.

    config ESP_MATTER_CONSOLE_NETWORK_PORT
        depends on ESP_MATTER_CONSOLE_NETWORK
        int "Telnet TCP port"
        range 1 65535
        default 23

    config ESP_MATTER_CONSOLE_TASK_STACK
        int "Task stack size"
        default 2048
        help
            Stack size of the console task.

    config ESP_MATTER_CONSOLE_MAX_COMMANDS
        int "Max commands supported"
        default 10
        help
            Maximum number of commands that can be added for the 'matter esp <sub_command>' command.

endmenu
```

## examples/controller/sdkconfig.defaults.esp32c6
```kconfig
CONFIG_IDF_TARGET="esp32c6"
CONFIG_ESPTOOLPY_FLASHSIZE_4MB=y
CONFIG_PARTITION_TABLE_CUSTOM=y
CONFIG_PARTITION_TABLE_CUSTOM_FILENAME="partitions.esp32c6.csv"

CONFIG_BT_ENABLED=y
CONFIG_BT_NIMBLE_ENABLED=y
CONFIG_BT_BLUEDROID_ENABLED=n
CONFIG_ENABLE_CHIPOBLE=y
CONFIG_ENABLE_ESP32_BLE_CONTROLLER=y
CONFIG_ENABLE_CHIP_CONTROLLER_BUILD=y
CONFIG_ESP_MATTER_CONTROLLER_ENABLE=y
CONFIG_ESP_MATTER_COMMISSIONER_ENABLE=y
CONFIG_SPIFFS_ATTESTATION_TRUST_STORE=y
CONFIG_ESP_MATTER_ENABLE_MATTER_SERVER=n
CONFIG_WIFI_NETWORK_COMMISSIONING_DRIVER=n
CONFIG_ENABLE_WIFI_STATION=y

CONFIG_OPENTHREAD_ENABLED=y
CONFIG_OPENTHREAD_RADIO_NATIVE=y
CONFIG_OPENTHREAD_BORDER_ROUTER=y
CONFIG_OPENTHREAD_LOG_LEVEL_DYNAMIC=n
CONFIG_OPENTHREAD_LOG_LEVEL_NOTE=y
CONFIG_OPENTHREAD_SRP_CLIENT=n
CONFIG_OPENTHREAD_DNS_CLIENT=n
CONFIG_THREAD_TASK_STACK_SIZE=8192
CONFIG_THREAD_NETWORK_COMMISSIONING_DRIVER=n
CONFIG_LWIP_IPV6_FORWARD=y
CONFIG_LWIP_NETIF_STATUS_CALLBACK=y
CONFIG_USE_MINIMAL_MDNS=n
CONFIG_ENABLE_EXTENDED_DISCOVERY=y
CONFIG_MDNS_MULTIPLE_INSTANCE=y
CONFIG_ENABLE_ROUTE_HOOK=n
CONFIG_MBEDTLS_KEY_EXCHANGE_ECJPAKE=y
CONFIG_MBEDTLS_ECJPAKE_C=y
CONFIG_MBEDTLS_SSL_PROTO_DTLS=y

CONFIG_ENABLE_CHIP_SHELL=y
CONFIG_ESP_MATTER_CONSOLE_USE_ESP_CONSOLE=y
CONFIG_ESP_MATTER_CONSOLE_NETWORK=y
CONFIG_ESP_CONSOLE_USB_SERIAL_JTAG=y
CONFIG_ESP_MATTER_CONSOLE_TASK_STACK=4096
CONFIG_CHIP_SHELL_CMD_LINE_BUF_MAX_LENGTH=512
CONFIG_CHIP_TASK_STACK_SIZE=24576
CONFIG_ESP_MAIN_TASK_STACK_SIZE=8192
CONFIG_NUM_UDP_ENDPOINTS=16

CONFIG_LWIP_HOOK_IP6_ROUTE_DEFAULT=y
CONFIG_LWIP_HOOK_ND6_GET_GW_DEFAULT=y
CONFIG_LWIP_IPV6_AUTOCONFIG=y
CONFIG_LWIP_IPV6_NUM_ADDRESSES=12
CONFIG_MBEDTLS_HKDF_C=y
CONFIG_CHIP_PROJECT_CONFIG="main/matter_project_config.h"
CONFIG_ESP_MATTER_MEM_ALLOC_MODE_INTERNAL=y
CONFIG_MBEDTLS_INTERNAL_MEM_ALLOC=y
```
